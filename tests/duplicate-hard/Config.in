## tests/duplicate-hard/Config.in
```kconfig
mainmenu "Hard duplicate fixture"
source "duplicate-a.in"
source "duplicate-b.in"
```

## tests/duplicate/Config.in
```kconfig
mainmenu "Duplicate fixture"
menu "First"
source "duplicate-a.in"
endmenu
menu "Second"
source "duplicate-b.in"
endmenu
```

## tests/fixture/Config.in
```kconfig
mainmenu "OpenWrt Configuration"

menu "Target System"
config TARGET_x86
	bool "x86"
config TARGET_x86_64
	bool "x86_64"
	depends on TARGET_x86
config TARGET_x86_64_DEVICE_generic
	bool "Generic x86/64"
	depends on TARGET_x86_64
config TARGET_x86_64_DEVICE_q35
	bool "QEMU Q35"
	depends on TARGET_x86_64
config TARGET_mediatek
	bool "MediaTek ARM"
config TARGET_mediatek_filogic
	bool "Filogic 8x0 (MT798x)"
	depends on TARGET_mediatek
config TARGET_mediatek_filogic_DEVICE_demo
	bool "Demo Router"
	depends on TARGET_mediatek_filogic
endmenu

menu "Target Images"
config TARGET_IMAGES_GZIP
	bool "GZip images"
	default y
endmenu

menu "LuCI"
menuconfig PACKAGE_luci
	tristate "LuCI"

if PACKAGE_luci
menu "Applications"
menuconfig PACKAGE_luci-app-demo
	tristate "Demo LuCI app"
	depends on TARGET_x86
	select PACKAGE_luci-base
	help
	  if the application is enabled, this sentence remains help text.
	  menu, endmenu and source are ordinary words inside help.

if PACKAGE_luci-app-demo
config PACKAGE_luci-app-demo-extra
	bool "Demo LuCI app extra feature"
endif

config PACKAGE_luci-i18n-demo-zh-cn
	tristate
	depends on PACKAGE_luci-app-demo
endmenu
endif
endmenu

choice
	prompt "Root filesystem"
config TARGET_ROOTFS_SQUASHFS
	bool "SquashFS"
config TARGET_ROOTFS_EXT4FS
	bool "ext4"
endchoice
```

## tests/kconfig-capabilities/Config.in
```kconfig
mainmenu "Kconfig capability golden fixture"

config GOLDEN_GATE
	bool "Golden gate"

config GOLDEN_A
	bool "Golden A"

config GOLDEN_B
	bool "Golden B"

config GOLDEN_C
	bool "Golden C"

config GOLDEN_VISIBLE
	bool "Golden visibility gate"

config GOLDEN_RANGE_GATE
	bool "Golden range gate"

config GOLDEN_PROMPT
	bool "Golden prompt gate"

config GOLDEN_RESET
	bool "Golden choice reset gate"

menu "Golden visibility"
	visible if GOLDEN_VISIBLE

config GOLDEN_BOOL
	bool "Golden bool" if GOLDEN_PROMPT
	depends on GOLDEN_A || GOLDEN_B && !GOLDEN_C
	default y if GOLDEN_GATE

config GOLDEN_STRING
	string "Golden string"
	default "foo if bar" if GOLDEN_GATE

config GOLDEN_INT
	int "Golden integer"
	range 1 64 if GOLDEN_RANGE_GATE

config GOLDEN_HEX
	hex "Golden hexadecimal"

config GOLDEN_MODULE
	tristate "Golden module"
	option modules

config GOLDEN_DUPLICATE
	prompt "Golden duplicate prompt"

source "definitions.in"
endmenu

choice GOLDEN_CHOICE
	prompt "Golden choice"
	tristate
	depends on GOLDEN_GATE
	visible if GOLDEN_VISIBLE
	help
		Choice help paragraph one.

		config, source and reset are help text here.
	reset if GOLDEN_RESET
	optional
	option modules
	default GOLDEN_CHOICE_A

config GOLDEN_CHOICE_A
	bool "Golden choice A"

config GOLDEN_CHOICE_B
	bool "Golden choice B"
endchoice
```

## tests/kconfig-choice-defaults/Config.in
```kconfig
mainmenu "Choice and scalar convergence"

config ENABLE_OWNER
	bool "Enable owner"

config BACKEND_AVAILABLE
	bool "Enable preferred backend"
	default y

if ENABLE_OWNER
source "backend-alternative.in"

config BACKEND_LIBRARY
	bool

config OWNER_TEXT
	string "Owner text"
	default "enabled" if BACKEND_LIBRARY
	default "alternative"

config OWNER_COUNT
	int "Owner count"
	default 12

config OWNER_MASK
	hex "Owner mask"
	default 0x20

config TRANSIENT_TEXT
	string
	depends on !BACKEND_LIBRARY
	default "!"

choice
	prompt "Optional backend"
	optional
	default OPTIONAL_MEMBER

config OPTIONAL_MEMBER
	bool "Optional member"

endchoice
endif
```

## tests/kconfig-compact-roundtrip/Config.in
```kconfig
mainmenu "Compact relation roundtrip"

config ROUNDTRIP_GATE
	bool "Roundtrip gate"

config ROUNDTRIP_RESET
	bool "Roundtrip reset"

menu "Roundtrip menu"
	visible if ROUNDTRIP_GATE

config ROUNDTRIP_TYPED
	string "Roundtrip typed default"
	default "first"   if ROUNDTRIP_GATE
	default "second"	if ROUNDTRIP_RESET
	range 1 64 if ROUNDTRIP_GATE

config ROUNDTRIP_DUP
	prompt "Roundtrip duplicate prompt"

source "definitions.in"
endmenu

choice ROUNDTRIP_CHOICE
	prompt "Roundtrip choice"
	tristate
	depends on ROUNDTRIP_GATE
	visible if ROUNDTRIP_GATE
	reset if ROUNDTRIP_RESET
	optional
	option modules
	default ROUNDTRIP_CHOICE_A

config ROUNDTRIP_CHOICE_A
	bool "Roundtrip choice A"

config ROUNDTRIP_CHOICE_B
	bool "Roundtrip choice B"
endchoice

# Real generated metadata can add defaults before a later type declaration.
config LATE_BOOL
 default y
config LATE_TRI
 default m
config LATE_STRING
 default "first"
config LATE_INT
 default 7
 range 1 16
config LATE_HEX
 default 0x2a
 range 0x1 0xff

config LATE_BOOL
 bool "Late bool"
config LATE_TRI
 tristate "Late tristate"
config LATE_STRING
 string "Late string"
config LATE_INT
 int "Late int"
config LATE_HEX
 hex "Late hex"
```

## tests/kconfig-dropbear/Config.in
```kconfig
mainmenu "Dropbear and host tools"

menu "Dropbear"
if PACKAGE_dropbear

config DROPBEAR_CHACHA20POLY1305
	bool "ChaCha20-Poly1305"
	default y
comment "KEX warning"
	depends on !DROPBEAR_CHACHA20POLY1305

config DROPBEAR_CLI_NETCAT
	bool "CLI netcat"
	default y
comment "CLI warning"
	depends on !DROPBEAR_CLI_NETCAT

config DROPBEAR_ECC_521
	bool "ECC 521"
	default y
comment "ECC warning"
	depends on !DROPBEAR_ECC_521

config DROPBEAR_ED25519
	bool "Ed25519"
	default y
comment "Ed25519 warning"
	depends on !DROPBEAR_ED25519

config DROPBEAR_ENABLE_GCM_MODE
	bool "GCM mode"
	default y
comment "GCM warning"
	depends on !DROPBEAR_ENABLE_GCM_MODE

config DROPBEAR_SHA2_512_HMAC
	bool "SHA2-512 HMAC"
	default y
comment "HMAC warning"
	depends on !DROPBEAR_SHA2_512_HMAC

config DROPBEAR_SK_ED25519
	bool "SK Ed25519"
	depends on DROPBEAR_SK_KEYS
	default y
comment "SK warning"
	depends on !DROPBEAR_SK_ED25519

config DROPBEAR_SNTRUP761
	bool "SNTRUP761"
	default y
comment "SNTRUP warning"
	depends on !DROPBEAR_SNTRUP761

endif
endmenu

config NASM
	bool "Build nasm" if TOOLCHAINOPTS
	depends on (i386 || x86_64)
	default y
comment "C Library"
	depends on TOOLCHAINOPTS
```

## tests/kconfig-help-zero/Config.in
```kconfig
config HELP_ZERO
	bool "Zero-column help"
help
Zero-column help text is retained exactly as a help block.
 config, source and reset are ordinary words here.
config HELP_ZERO_NEXT
	bool "Directive after zero-column help"
```

## tests/kconfig-package-selector/Config.in
```kconfig
mainmenu "OpenWrt package selector fixture"

config PACKAGE_selector-source
	tristate "Package selector source"
	depends on @(!boost-shared-libs&&!boost-static-and-shared-libs)
```

## tests/kconfig-semantics/Config.in
```kconfig
mainmenu "Kconfig semantic boundaries"

menu "Outer menu"
depends on OUTER_GATE
visible if OUTER_VISIBLE

config OUTER_OPTION
	bool "Outer option"
	default y

if IF_GATE
config IF_OPTION
	bool "Prompt guarded option" if PROMPT_GATE
	depends on DIRECT_GATE
	default y

comment "A warning must not modify IF_OPTION"
	depends on !IF_OPTION

source "nested.in"

config AFTER_COMMENT
	bool "After comment"
	default y
endif

choice
	prompt "Choice"
	depends on CHOICE_GATE
	visible if CHOICE_VISIBLE
	default CHOICE_A
config CHOICE_A
	bool "Choice A"
config CHOICE_B
	bool "Choice B"
endchoice

comment "A comment followed by a menu"
	depends on !AFTER_COMMENT

menu "Trailing menu"
depends on TRAILING_GATE
visible if TRAILING_VISIBLE
config TRAILING_OPTION
	def_bool y
help
	The words menu, source, choice and depends on here are help text.
endmenu

endmenu
```

## tests/kconfig-source/Config.in
```kconfig
mainmenu "Source expansion"

source "root-fallback.in"
source "glob/*/Config.in"
source "glob/zero/*/Config.in"
source "nested/Config.in"
source "dynamic.in"
osource "optional-missing.in"
orsource "optional-relative.in"
```

## tests/kconfig-source/nested/Config.in
```kconfig
source "nested-only.in"
source "ordinary/*/Config.in"
source "q?local.in"
rsource "relative.in"
rsource "local/*/Config.in"
```

## tests/kconfig-undefined/Config.in
```kconfig
mainmenu "Kconfig undefined-symbol fixture"

config UNDEFINED_ROOT
	bool "Undefined root"
	depends on UNDEFINED_CONTEXT
	default UNDEFINED_DEFAULT

config UNDEFINED_STRING
	string "Undefined string"
	default UNDEFINED_STRING_DEFAULT if UNDEFINED_STRING_GATE

config UNDEFINED_INT
	int "Undefined integer"
	range UNDEFINED_MIN UNDEFINED_MAX if UNDEFINED_RANGE_GATE

config DEFINED_BUT_OMITTED
	bool "Defined but omitted from graph"

config OMITTED_REFERENCE_ROOT
	bool "Omitted reference root"
	depends on DEFINED_BUT_OMITTED

choice UNDEFINED_CHOICE
	bool "Undefined choice"
	depends on UNDEFINED_CHOICE_CONTEXT
	reset if UNDEFINED_CHOICE_RESET

config UNDEFINED_CHOICE_MEMBER
	bool "Undefined choice member"
endchoice
```
